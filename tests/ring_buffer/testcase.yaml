## tests/ring_buffer/testcase.yaml
```yaml
tests:
  RingBuffer.ring_buffer.unit:
    platform_allow:
      - native_sim
    tags:
      - ring_buffer
      - unit
    integration_platforms:
      - native_sim
```
