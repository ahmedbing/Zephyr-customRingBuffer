## CMakeLists.txt
```
cmake_minimum_required(VERSION 3.20.0)

find_package(Zephyr REQUIRED HINTS $ENV{ZEPHYR_BASE})
project(RingBuffer)

target_sources(app PRIVATE
    src/main.c
    lib/ring_buffer.c
    lib/ema.c
)

target_include_directories(app PRIVATE
    include
)
```

## Kconfig
```
# SPDX-License-Identifier: Apache-2.0

mainmenu "RingBuffer"

menu "RingBuffer application configuration"

config APP_RING_BUFFER_CAPACITY
    int "Ring buffer capacity"
    default 10
    range 1 256
    help
      Number of heart-rate samples stored in the ring buffer.

config APP_PRODUCER_PERIOD_SECONDS
    int "Producer period in seconds"
    default 1
    range 1 60
    help
      Interval between generated heart-rate samples.

config APP_PRODUCER_START_DELAY_MS
    int "Producer thread startup delay in milliseconds"
    default 100
    range 0 1000
    help
      Delay before the producer thread starts generating samples in initialization.

config APP_CONSUMER_PERIOD_SECONDS
    int "Consumer period in seconds"
    default 10
    range 1 600
    help
      Interval between EMA calculations and reports.

config APP_CONSUMER_START_DELAY_MS
    int "Consumer thread startup delay in milliseconds"
    default 200
    range 0 1000
    help
      Delay before the consumer thread starts generating samples in initialization.

config APP_THREAD_STACK_SIZE
    int "Application thread stack size"
    default 1024
    range 512 4096
    help
      Stack size used by producer and consumer threads.

config APP_THREAD_PRIORITY
    int "Application thread priority"
    default 5
    range -16 15
    help
      Zephyr priority used by the application threads.

endmenu

source "Kconfig.zephyr"
```

## west.yml
```
manifest:
  projects:
    - name: sdk-nrf
      path: nrf
      url: https://github.com/nrfconnect/sdk-nrf.git
      revision: v3.2.0
      import: true

  self:
    path: app
```

## prj.conf
```kconfig
CONFIG_CONSOLE=y
CONFIG_PRINTK=y
CONFIG_STDOUT_CONSOLE=y
CONFIG_MAIN_STACK_SIZE=1024
CONFIG_LOG=y
CONFIG_LOG_MODE_IMMEDIATE=y
CONFIG_LOG_DEFAULT_LEVEL=3

CONFIG_APP_RING_BUFFER_CAPACITY=20
CONFIG_APP_PRODUCER_PERIOD_SECONDS=1
CONFIG_APP_CONSUMER_PERIOD_SECONDS=10
CONFIG_APP_THREAD_STACK_SIZE=1024
CONFIG_APP_THREAD_PRIORITY=5
```

## src/main.c
```c
#include <zephyr/kernel.h>
#include <zephyr/random/random.h>
#include <zephyr/sys/printk.h>

#include "ema.h"
#include "ring_buffer.h"

#define HR_MIN_VALUE 44
#define HR_MAX_VALUE 185
#define HR_RANGE (HR_MAX_VALUE - HR_MIN_VALUE + 1)

static struct ring_buffer hr_ring_buffer;
static ring_buffer_data_t hr_storage[CONFIG_APP_RING_BUFFER_CAPACITY];

/* Protect shared ring buffer access between producer and consumer threads. */
K_MUTEX_DEFINE(hr_buffer_mutex);

/**
 * @brief Generate one simulated heart-rate sample in the range [44, 185].
 */
static int generate_hr_sample(void) {
    return (int)(HR_MIN_VALUE + (sys_rand32_get() % HR_RANGE));
}

/**
 * @brief Producer thread.
 *
 * Generates one heart-rate sample every second and stores it in the shared
 * ring buffer. When the buffer is full, the oldest sample is removed first so
 * the buffer always contains the latest window of data.
 */
static void producer_thread_cb(void *p1, void *p2, void *p3) {
    ARG_UNUSED(p1);
    ARG_UNUSED(p2);
    ARG_UNUSED(p3);

    while (1) {
        int sample = generate_hr_sample();
        ring_buffer_data_t dropped_sample;
        size_t current_size = 0U;

        k_mutex_lock(&hr_buffer_mutex, K_FOREVER);

        if (ring_buffer_is_full(&hr_ring_buffer)) {
            (void)ring_buffer_get(&hr_ring_buffer, &dropped_sample);
            printk("Producer: buffer full, dropped oldest sample=%d bpm\n", dropped_sample);
        }

        (void)ring_buffer_put(&hr_ring_buffer, (ring_buffer_data_t)sample);
        current_size = ring_buffer_get_size(&hr_ring_buffer);

        k_mutex_unlock(&hr_buffer_mutex);

        printk("Producer: HR=%d bpm, buffer_size=%zu\n", sample, current_size);

        k_sleep(K_SECONDS(CONFIG_APP_PRODUCER_PERIOD_SECONDS));
    }
}

/**
 * @brief Consumer thread.
 *
 * Every 10 seconds, copies all currently stored samples from the shared ring
 * buffer, computes the EMA from those samples, and reports the result.
 *
 * The EMA calculation is done outside the mutex-protected section so the
 * shared buffer is locked only for the short copy operation.
 */
static void consumer_thread_cb(void *p1, void *p2, void *p3) {
    ARG_UNUSED(p1);
    ARG_UNUSED(p2);
    ARG_UNUSED(p3);

    ring_buffer_data_t samples[CONFIG_APP_RING_BUFFER_CAPACITY];
    size_t sample_count = 0U;
    float ema = 0.0f;

    while (1) {
        k_sleep(K_SECONDS(CONFIG_APP_CONSUMER_PERIOD_SECONDS));

        k_mutex_lock(&hr_buffer_mutex, K_FOREVER);
        ring_buffer_status_t status = ring_buffer_drain(
            &hr_ring_buffer, samples, CONFIG_APP_RING_BUFFER_CAPACITY, &sample_count);
        k_mutex_unlock(&hr_buffer_mutex);

        if (status == RING_BUFFER_ERROR_EMPTY) {
            printk("Consumer: no samples available\n");
            continue;
        }

        if (status != RING_BUFFER_SUCCESS) {
            printk("Consumer: failed to fetch samples\n");
            continue;
        }

        if (!ema_calculation(samples, sample_count, &ema)) {
            printk("Consumer: EMA calculation failed\n");
            continue;
        }

        int ema_x100 = (int)(ema * 100.0f + 0.5f);
        printk("Consumer: fetched=%zu, EMA=%d.%02d bpm\n", sample_count, ema_x100 / 100,
               ema_x100 % 100);
    }
}

/*
 * Statically create both threads.
 * Startup delays give main() time to initialize the shared ring buffer before
 * producer and consumer begin their periodic work.
 */
K_THREAD_DEFINE(producer_tid, CONFIG_APP_THREAD_STACK_SIZE, producer_thread_cb, NULL, NULL, NULL,
                CONFIG_APP_THREAD_PRIORITY, 0, CONFIG_APP_PRODUCER_START_DELAY_MS);

K_THREAD_DEFINE(consumer_tid, CONFIG_APP_THREAD_STACK_SIZE, consumer_thread_cb, NULL, NULL, NULL,
                CONFIG_APP_THREAD_PRIORITY, 0, CONFIG_APP_CONSUMER_START_DELAY_MS);

int main(void) {
    ring_buffer_status_t status;

    status = ring_buffer_init(&hr_ring_buffer, hr_storage, CONFIG_APP_RING_BUFFER_CAPACITY);

    if (status != RING_BUFFER_SUCCESS) {
        printk("Failed to initialize ring buffer\n");
        return -1;
    }

    printk("Heart-rate simulation app started\n");
    printk("Buffer capacity: %d\n", CONFIG_APP_RING_BUFFER_CAPACITY);
    printk("Producer period: %d s\n", CONFIG_APP_PRODUCER_PERIOD_SECONDS);
    printk("Consumer period: %d s\n", CONFIG_APP_CONSUMER_PERIOD_SECONDS);

    return 0;
}
```

## include/ema.h
```c
#pragma once

#include <stdbool.h>
#include <stddef.h>
#include <stdint.h>

#ifdef __cplusplus
extern "C" {
#endif

/**
 * @brief Calculate the Exponential Moving Average (EMA) of a sample array.
 *
 * This function calculates the EMA over the provided input samples using the
 * standard recursive exponential smoothing formula:
 *     EMA_0 = x_0
 *     EMA_n = alpha * x_n + (1 - alpha) * EMA_(n-1)
 *
 * The first sample is used as the initial EMA value.
 *
 * @param samples Pointer to the input sample array.
 * @param sample_size Number of valid samples in the input array.
 * @param output_ema Pointer to the output variable where the calculated EMA
 *
 * @return true if the EMA was calculated successfully, otherwise false.
 */
bool ema_calculation(const int *samples, size_t sample_size, float *output_ema);

#ifdef __cplusplus
}
#endif
```

## include/ring_buffer.h
```c
#pragma once

#include <stdbool.h>
#include <stddef.h>

#ifdef __cplusplus
extern "C" {
#endif

typedef int ring_buffer_data_t;

typedef enum {
    RING_BUFFER_SUCCESS = 0,
    RING_BUFFER_ERROR_FULL,
    RING_BUFFER_ERROR_EMPTY,
    RING_BUFFER_ERROR_INIT_FAILED,
    RING_BUFFER_ERROR_INVALID_CAPACITY,
    RING_BUFFER_ERROR_INVALID_ARGUMENT
} ring_buffer_status_t;

struct ring_buffer {
    ring_buffer_data_t *buffer;
    size_t capacity;
    size_t head;
    size_t tail;
    size_t count;
};

/**
 * @brief Initialize a ring buffer instance with caller-provided storage.
 *
 * This function prepares the ring buffer for use by assigning the backing
 * storage area, setting the capacity, and resetting internal indices/state.
 *
 * @param rb Pointer to the ring buffer instance to initialize.
 * @param storage Pointer to the caller-allocated storage array.
 * @param capacity Maximum number of elements the buffer can store.
 *
 * @return RING_BUFFER_STATUS_OK on success, otherwise an error status.
 */
ring_buffer_status_t ring_buffer_init(struct ring_buffer *rb, ring_buffer_data_t *storage,
                                      size_t capacity);

/**
 * @brief Clear all contents of the ring buffer.
 *
 * This function resets the buffer to an empty state without modifying the
 * underlying storage memory.
 *
 * @param rb Pointer to the ring buffer instance.
 */
void ring_buffer_clear(struct ring_buffer *rb);

/**
 * @brief Insert one element into the ring buffer.
 *
 * Stores a new element at the write position if space is available.
 *
 * @param rb Pointer to the ring buffer instance.
 * @param data Element to be written into the buffer.
 *
 * @return RING_BUFFER_STATUS_OK on success, otherwise an error status
 *         such as full buffer or invalid argument.
 */
ring_buffer_status_t ring_buffer_put(struct ring_buffer *rb, ring_buffer_data_t data);

/**
 * @brief Remove one element from the ring buffer.
 *
 * Retrieves the oldest available element from the buffer if the buffer is
 * not empty.
 *
 * @param rb Pointer to the ring buffer instance.
 * @param data Pointer to the output location for the retrieved element.
 *
 * @return RING_BUFFER_STATUS_OK on success, otherwise an error status
 *         such as empty buffer or invalid argument.
 */
ring_buffer_status_t ring_buffer_get(struct ring_buffer *rb, ring_buffer_data_t *data);

/**
 * @brief Remove and return all currently stored elements in FIFO order.
 *
 * Copies all available elements from the ring buffer into the
 * caller-provided output array and removes them from the buffer.
 *
 * @param rb Pointer to the ring buffer instance.
 * @param out_buffer Pointer to the destination array.
 * @param out_capacity Capacity of the destination array.
 * @param drained_count Pointer to the variable that receives the number of
 *        copied elements.
 * @return RING_BUFFER_SUCCESS on success, otherwise an error status such as
 *         empty buffer or invalid argument.
 */
ring_buffer_status_t ring_buffer_drain(struct ring_buffer *rb, ring_buffer_data_t *out_buffer,
                                       size_t out_capacity, size_t *drained_count);

/**
 * @brief Check whether the ring buffer is empty.
 *
 * @param rb Pointer to the ring buffer instance.
 *
 * @return true if the buffer contains no elements, otherwise false.
 */
bool ring_buffer_is_empty(const struct ring_buffer *rb);

/**
 * @brief Check whether the ring buffer is full.
 *
 * @param rb Pointer to the ring buffer instance.
 *
 * @return true if the buffer has reached its capacity, otherwise false.
 */
bool ring_buffer_is_full(const struct ring_buffer *rb);

/**
 * @brief Get the current number of stored elements.
 *
 * @param rb Pointer to the ring buffer instance.
 *
 * @return Number of valid elements currently stored in the buffer.
 */
size_t ring_buffer_get_size(const struct ring_buffer *rb);

#ifdef __cplusplus
}
#endif
```
